## image.its
```
/dts-v1/;

/ {
	description = "U-Boot fitImage for plnx_arm kernel";
	#address-cells = <1>;

	images {
		kernel@0 {
			description = "Linux Kernel";
			data = /incbin/("/home/lido/linux-adi/arch/arm/boot/zImage");
			type = "kernel";
			arch = "arm";
			os = "linux";
			compression = "none";
			load = <0x8000>;
			entry = <0x8000>;
			hash@1 {
				algo = "sha1";
			};
		};
		fdt@0 {
			description = "Flattened Device Tree blob";
			data = /incbin/("/home/lido/linux-adi/arch/arm/boot/dts/insys/zynq-zc706-adv7511-adrv9371.dtb");
			type = "flat_dt";
			arch = "arm";
			compression = "none";
			hash@1 {
				algo = "sha1";
			};
		};
	};
	configurations {
		default = "conf@2";
		conf@2 {
			description = "Boot Linux kernel with FDT blob";
			kernel = "kernel@0";
			fdt = "fdt@0";
			hash@1 {
				algo = "sha1";
			};
		};
	};
};
```
